## drivers/Kconfig
```kconfig
menu "Drivers"
rsource "ir_led_sequencer/Kconfig"
rsource "remote_control/Kconfig"
endmenu
```

## drivers/ir_led_sequencer/Kconfig
```kconfig
menuconfig IR_LED_SEQUENCER
	bool "IR LED sequencer drivers"
	help
	  This option enables the IR LED sequencer driver class.

if IR_LED_SEQUENCER

module = IR_LED_SEQUENCER
module-str = ir_led_sequencer
source "subsys/logging/Kconfig.template.log_config"

config PWM_IR_LED_SEQUENCER
	bool "PWM IR LED sequencer"
	default y
	depends on DT_HAS_PWM_IR_LED_SEQUENCER_ENABLED
	select GPIO
	select PWM
	help
	  Enable this option to use the PWM IR LED sequencer driver.


endif # IR_LED_SEQUENCER
```

## drivers/remote_control/Kconfig
```kconfig
menuconfig REMOTE_CONTROL
	bool "Remote control drivers"
	help
	  This option enables the remote control driver class.

if REMOTE_CONTROL

module = REMOTE_CONTROL
module-str = remote_control
source "subsys/logging/Kconfig.template.log_config"

rsource "Kconfig.remote_control_rc5"

endif # REMOTE_CONTROL
```

## drivers/remote_control/Kconfig.benq_th534
```kconfig
config REMOTE_CONTROL_BENQ_TH534
	bool "BenQ TH534 IR NEC remote control protocol"
	default y
	depends on DT_HAS_REMOTE_CONTROL_BENQ_TH534_ENABLED
	select IR_LED_SEQUENCER
	help
	  Enable this option to use the BenQ TH534 IR remote control driver.
```

## drivers/remote_control/Kconfig.celexon_ev1527
```kconfig
config REMOTE_CONTROL_CELEXON_EV1527
	bool "Celexon EV1527 OTP remote control protocol"
	default y
	depends on DT_HAS_CELEXON_EV1527_ENABLED
	select GPIO
	help
	  Enable this option to use the Celexon screen via the EV1527 OTP chip remote control driver.
```

## drivers/remote_control/Kconfig.remote_control_rc5
```kconfig
config REMOTE_CONTROL_RC5
	bool "RC5 protocol remote control"
	default y
	depends on DT_HAS_REMOTE_CONTROL_RC5_ENABLED
	select GPIO
	select PWM
	help
	  Enable this option to use the RC5 remote control driver.
```

## dts/bindings/ir_led_sequencer/pwm-ir-led-sequencer.yaml
```yaml
description: A PWM-based IR LED sequencer

compatible: "pwm-ir-led-sequencer"

include: base.yaml

properties:
  pwms:
    type: phandle-array
    required: true
    description: GPIO/PWM-controlled IR LED.
```

## dts/bindings/remote_control/celexon-ev1527.yaml
```yaml
description: |
  A remote control driver for the Celexon projector screen with an EV1527 OTP (One-Time Programmable) chip.

compatible: "celexon-ev1527"

include: base.yaml

properties:
  tx-gpios:
    type: phandle-array
    description: TX pin that is connected to the OOK TX module
    required: true
  otp-code:
    type: int
    description: OTP code of the EV1527 chip
```

## dts/bindings/remote_control/remote-control-benq-th534.yaml
```yaml
description: |
  A remote control driver using the BenQ TH534 protocol.

compatible: "remote-control-benq-th534"

include: base.yaml

properties:
  ir-led-sequencer:
    type: phandle
    required: true
    description: IR LED sequencer sending the bursts
```

## dts/bindings/remote_control/remote-control-rc5.yaml
```yaml
description: |
  A remote control driver using the RC5 protocol.

compatible: "remote-control-rc5"

include: base.yaml

properties:
  ir-led-sequencer:
    type: phandle
    required: true
    description: IR LED sequencer sending the bursts
```

## west.yml
```yaml
manifest:
  self:
    west-commands: scripts/west-commands.yml

  remotes:
    - name: zephyrproject-rtos
      url-base: https://github.com/zephyrproject-rtos

  projects:
    - name: zephyr
      remote: zephyrproject-rtos
      revision: v4.2.1
      import:
        # By using name-allowlist we can clone only the modules that are
        # strictly needed by the application.
        name-allowlist:
          - cmsis_6    # required by the ARM port
          - hal_stm32  # required by the nucleo_f302r8 board (STM32 based)
```
